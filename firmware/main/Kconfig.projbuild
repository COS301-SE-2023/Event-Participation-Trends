## firmware/main/Kconfig.projbuild
```kconfig
menu "EventParticipationTrends"
    config MESH_ROUTER_SSID
        string "Router SSID"
        default "ROUTER_SSID"
        help
            Router SSID (To be used during normal operation).
    config MESH_ROUTER_PASSWD
        string "Router password"
        default "ROUTER_PASSWD"
        help
            Router password (To be used during normal operation).
    menu "MQTT"
        config MQTT_BROKER_URL
            string "MQTT Broker URL"
            default "wss://example.com:8883"
            help
                This is the URL to a WSS-enabled MQTT broker that will be used.
        config MQTT_BROKER_USERNAME
            string "MQTT Broker Username"
            default "mqttbrokerusername"
            help
                This is the username used to authenticate with the MQTT broker.
        config MQTT_BROKER_PASSWD
            string "MQTT Broker Password"
            default  "mqttbrokerpassword"
            help
                This is the password used to authenticate with the MQTT broker.
        config MQTT_TOPIC_DEVICES
            string "MQTT Topic Detected Devices"
            default "/sensor"
            help
                This is the MQTT topic to which all detected Bluetooth Devices will be published.
        config MQTT_TOPIC_DEBUG
            string "MQTT Topic Debug"
            default "/debug"
            help
                This is the MQTT topic to which any debug info will be published to.
        config MQTT_TOPIC_LWT
            string "MQTT Topic for LWT"
            default "/LWT"
            help
                This is a topic to which a sensors' Last Will and Testament will be published.
                Their LWT consists of the MAC-ADDRESS that is unique to every sensor.
        config MQTT_TOPIC_CONNECTED
            string "MQTT Topic for newly connected devices"
            default "/CONNECTED"
            help
                This is the MQTT topic to which a device will publish it's own MAC-ADDRESS when it connects.
    endmenu
    menu "OTA Update"
        config OTA_ENABLE
            bool "Enable OTA Update"
            default y
            help
                Enable/Disable OTA update.
        config OTA_SERVER_URL
            string "OTA server URL"
            depends on OTA_ENABLE
            default "https://example.com/firmware.bin"
            help
                This is the URL that points to the binary file on an https server.
                (This has to be an https capable domain)
        config OTA_ROUTER_SSID
            string "Router SSID"
            depends on OTA_ENABLE
            default "ROUTER_SSID"
            help
                Router SSID that will be used for OTA updates.
        config OTA_ROUTER_PASSWD
            string "Router password"
            depends on OTA_ENABLE
            default "ROUTER_PASSWD"
            help
                Router password that will be used for OTA updates.
        config OTA_MAX_RETRY
            int "Max OTA Connection retries"
            depends on OTA_ENABLE
            range 1 100
            default 5
            help
                Mesh PS device duty cycle.
    endmenu
    menu "MESH"
        config MESH_ENABLE
            bool "MESH_ENABLE"
            default y
            help
                Mesh Bypass.
        menu "MESH Config"
            depends on MESH_ENABLE
            choice
                bool "Mesh Topology"
                default MESH_TOPO_TREE
                help
                    Mesh Network Topology.
        
                config MESH_TOPO_TREE
                    bool "MESH_TOPO_TREE"
                config MESH_TOPO_CHAIN
                    bool "MESH_TOPO_CHAIN"
            endchoice
        
            config MESH_TOPOLOGY
                int
                default 0 if MESH_TOPO_TREE
                default 1 if MESH_TOPO_CHAIN
                help
                    Mesh Network Topology.
        
            config MESH_ENABLE_PS
                bool "Enable mesh PS (power save) function"
                default y
                help
                    Enable/Disable Power Save function.
        
            choice
                bool "Mesh PS device duty cycle type"
                depends on MESH_ENABLE_PS
                default MESH_PS_DEV_DUTY_TYPE_REQUEST
                help
                    Mesh PS device duty cycle type.
        
                config MESH_PS_DEV_DUTY_TYPE_REQUEST
                    bool "MESH_PS_DEV_DUTY_TYPE_REQUEST"
                config MESH_PS_DEV_DUTY_TYPE_DEMAND
                    bool "MESH_PS_DEV_DUTY_TYPE_DEMAND"
            endchoice
        
            config MESH_PS_DEV_DUTY_TYPE
                int
                depends on MESH_ENABLE_PS
                default 1 if MESH_PS_DEV_DUTY_TYPE_REQUEST
                default 4 if MESH_PS_DEV_DUTY_TYPE_DEMAND
                help
                    Mesh PS device duty cycle type.
        
            config MESH_PS_DEV_DUTY
                int "Mesh PS device duty cycle"
                depends on MESH_ENABLE_PS
                range 1 100
                default 10
                help
                    Mesh PS device duty cycle.
        
            config MESH_PS_NWK_DUTY
                int "Mesh PS network duty cycle"
                depends on MESH_ENABLE_PS
                range 1 100
                default 10
                help
                    Mesh PS network duty cycle.
        
            config MESH_PS_NWK_DUTY_DURATION
                int "Mesh PS network duty cycle duration (unit: minutes)"
                depends on MESH_ENABLE_PS
                range -1 100
                default -1
                help
                    Mesh PS network duty cycle duration.
        
            choice
                bool "Mesh PS network duty cycle rule"
                depends on MESH_ENABLE_PS
                default MESH_PS_NETWORK_DUTY_APPLIED_ENTIRE
                help
                    Mesh PS network duty cycle rule.
        
                config MESH_PS_NETWORK_DUTY_APPLIED_ENTIRE
                    bool "MESH_PS_NETWORK_DUTY_APPLIED_ENTIRE"
                config MESH_PS_NETWORK_DUTY_APPLIED_UPLINK
                    bool "MESH_PS_NETWORK_DUTY_APPLIED_UPLINK"
            endchoice
        
            config MESH_PS_NWK_DUTY_RULE
                int
                depends on MESH_ENABLE_PS
                default 0 if MESH_PS_NETWORK_DUTY_APPLIED_ENTIRE
                default 1 if MESH_PS_NETWORK_DUTY_APPLIED_UPLINK
                help
                    Mesh PS network duty cycle rule.
        
            config MESH_MAX_LAYER
                int "Mesh Max Layer"
                range 1 25 if MESH_TOPO_TREE
                range 1 1000 if MESH_TOPO_CHAIN
                default 6
                help
                    Max layer allowed in mesh network.
        
            config MESH_CHANNEL
                int "channel"
                range 0 14
                default 0
                help
                    mesh network channel.
            choice
                bool "Mesh AP Authentication Mode"
                default WIFI_AUTH_WPA2_PSK
                help
                    Authentication mode.
        
                config WIFI_AUTH_OPEN
                    bool "WIFI_AUTH_OPEN"
                config WIFI_AUTH_WPA_PSK
                    bool "WIFI_AUTH_WPA_PSK"
                config WIFI_AUTH_WPA2_PSK
                    bool "WIFI_AUTH_WPA2_PSK"
                config WIFI_AUTH_WPA_WPA2_PSK
                    bool "WIFI_AUTH_WPA_WPA2_PSK"
            endchoice
        
            config MESH_AP_AUTHMODE
                int
                default 0 if WIFI_AUTH_OPEN
                default 2 if WIFI_AUTH_WPA_PSK
                default 3 if WIFI_AUTH_WPA2_PSK
                default 4 if WIFI_AUTH_WPA_WPA2_PSK
                help
                    Mesh AP authentication mode.
        
            config MESH_AP_PASSWD
                string "Mesh AP Password"
                default "MAP_PASSWD"
                help
                    Mesh AP password.
        
            config MESH_AP_CONNECTIONS
                int "Mesh AP Connections"
                range 1 10
                default 6
                help
                    The number of mesh stations allowed to connect in.
        
            config MESH_NON_MESH_AP_CONNECTIONS
                int "Mesh Non Mesh AP Connections"
                range 0 9
                default 0
                help
                    The number of non-mesh stations allowed to connect in.
        
            config MESH_ROUTE_TABLE_SIZE
                int "Mesh Routing Table Size"
                range 1 300
                default 50
                help
                    The number of devices over the network(max: 300).
        endmenu
    endmenu
endmenu
```
